//
// iceZ0mb1e - FPGA 8-Bit TV80 SoC for Lattice iCE40
// with complete open-source toolchain flow using yosys and SDCC
//
// Copyright (c) 2018 Franz Neumann (netinside2000@gmx.de)
//
// Permission is hereby granted, free of charge, to any person obtaining a 
// copy of this software and associated documentation files (the "Software"), 
// to deal in the Software without restriction, including without limitation 
// the rights to use, copy, modify, merge, publish, distribute, sublicense, 
// and/or sell copies of the Software, and to permit persons to whom the 
// Software is furnished to do so, subject to the following conditions:
//
// The above copyright notice and this permission notice shall be included 
// in all copies or substantial portions of the Software.
//
// THE SOFTWARE IS PROVIDED "AS IS", WITHOUT WARRANTY OF ANY KIND, 
// EXPRESS OR IMPLIED, INCLUDING BUT NOT LIMITED TO THE WARRANTIES OF 
// MERCHANTABILITY, FITNESS FOR A PARTICULAR PURPOSE AND NONINFRINGEMENT. 
// IN NO EVENT SHALL THE AUTHORS OR COPYRIGHT HOLDERS BE LIABLE FOR ANY 
// CLAIM, DAMAGES OR OTHER LIABILITY, WHETHER IN AN ACTION OF CONTRACT, 
// TORT OR OTHERWISE, ARISING FROM, OUT OF OR IN CONNECTION WITH THE 
// SOFTWARE OR THE USE OR OTHER DEALINGS IN THE SOFTWARE.
//

#include <stdint.h>
#include "mini-printf.h"
#include "icez0mb1e.h"
#include "cpu.h"
#include "uart.h"
#include "i2c.h"
#include "spi.h"
#include "ssd1306.h"

int8_t start = 0;
uint16_t last_usable_addr = 0;
int8_t free = 0;
char strbuf[80];

void Read_SPI_25L008A(uint8_t *buffer, uint16_t len)
{
    uint8_t spi_send[4] = {0x3, 0x00, 0x00, 0x00};

    spi_xfer(spi_send, buffer, 4, len);
}

void oled_reset()
{
    port_b = 0x00;
    delay(50000);
    port_b = 0x01;
    delay(50000);
    port_b = 0x00;
    delay(50000);
    port_b = 0x01;
    delay(50000);
}

void View_Memory(uint8_t *mem, uint16_t len)
{
    uint16_t x;

    for(x = 0; x < len; x++)
    {
        if((x%16) == 0)
        {
            snprintf(strbuf, sizeof(strbuf), "\r\n%04X: ", x);
            uart_write(strbuf);
        }
        snprintf(strbuf, sizeof(strbuf), "%02X", mem[x]);
        uart_write(strbuf);
    }

    snprintf(strbuf, sizeof(strbuf), "\r\n");
    uart_write(strbuf);
}

/* spi lcd start */
#define ILI9341_TFTWIDTH  240
#define ILI9341_TFTHEIGHT 320

#define ILI9341_NOP     0x00
#define ILI9341_SWRESET 0x01
#define ILI9341_RDDID   0x04
#define ILI9341_RDDST   0x09

#define ILI9341_SLPIN   0x10
#define ILI9341_SLPOUT  0x11
#define ILI9341_PTLON   0x12
#define ILI9341_NORON   0x13

#define ILI9341_RDMODE  0x0A
#define ILI9341_RDMADCTL  0x0B
#define ILI9341_RDPIXFMT  0x0C
#define ILI9341_RDIMGFMT  0x0D
#define ILI9341_RDSELFDIAG  0x0F

#define ILI9341_INVOFF  0x20
#define ILI9341_INVON   0x21
#define ILI9341_GAMMASET 0x26
#define ILI9341_DISPOFF 0x28
#define ILI9341_DISPON  0x29

#define ILI9341_CASET   0x2A
#define ILI9341_PASET   0x2B
#define ILI9341_RAMWR   0x2C
#define ILI9341_RAMRD   0x2E

#define ILI9341_PTLAR   0x30
#define ILI9341_MADCTL  0x36
#define ILI9341_PIXFMT  0x3A

#define ILI9341_FRMCTR1 0xB1
#define ILI9341_FRMCTR2 0xB2
#define ILI9341_FRMCTR3 0xB3
#define ILI9341_INVCTR  0xB4
#define ILI9341_DFUNCTR 0xB6

#define ILI9341_PWCTR1  0xC0
#define ILI9341_PWCTR2  0xC1
#define ILI9341_PWCTR3  0xC2
#define ILI9341_PWCTR4  0xC3
#define ILI9341_PWCTR5  0xC4
#define ILI9341_VMCTR1  0xC5
#define ILI9341_VMCTR2  0xC7

#define ILI9341_RDID1   0xDA
#define ILI9341_RDID2   0xDB
#define ILI9341_RDID3   0xDC
#define ILI9341_RDID4   0xDD

#define ILI9341_GMCTRP1 0xE0
#define ILI9341_GMCTRN1 0xE1
/*
#define ILI9341_PWCTR6  0xFC

*/

// Color definitions
#define ILI9341_BLACK       0x0000      /*   0,   0,   0 */
#define ILI9341_NAVY        0x000F      /*   0,   0, 128 */
#define ILI9341_DARKGREEN   0x03E0      /*   0, 128,   0 */
#define ILI9341_DARKCYAN    0x03EF      /*   0, 128, 128 */
#define ILI9341_MAROON      0x7800      /* 128,   0,   0 */
#define ILI9341_PURPLE      0x780F      /* 128,   0, 128 */
#define ILI9341_OLIVE       0x7BE0      /* 128, 128,   0 */
#define ILI9341_LIGHTGREY   0xC618      /* 192, 192, 192 */
#define ILI9341_DARKGREY    0x7BEF      /* 128, 128, 128 */
#define ILI9341_BLUE        0x001F      /*   0,   0, 255 */
#define ILI9341_GREEN       0x07E0      /*   0, 255,   0 */
#define ILI9341_CYAN        0x07FF      /*   0, 255, 255 */
#define ILI9341_RED         0xF800      /* 255,   0,   0 */
#define ILI9341_MAGENTA     0xF81F      /* 255,   0, 255 */
#define ILI9341_YELLOW      0xFFE0      /* 255, 255,   0 */
#define ILI9341_WHITE       0xFFFF      /* 255, 255, 255 */
#define ILI9341_ORANGE      0xFD20      /* 255, 165,   0 */
#define ILI9341_GREENYELLOW 0xAFE5      /* 173, 255,  47 */
#define ILI9341_PINK        0xF81F


#if 0
#define GPIO_TFT_DC     (0xAA)
#define GPIO_SPI_CS     (0xAF)
#define GPIO_SPI_CLK    (0xAC)
#define GPIO_SPI_MOSI   (0xAE)
#define GPIO_SPI_MISO   (0xAD)
#endif

#define GPIO_TFT_DC     (0)

#if 0
void delay(int x)
{
        int i, j;
        for(i = 0; i < x; i++) {
            for(j = 0; j < 100; j++) {
        }
    }
}
#endif

#define _OUTPUT  1
#define _INPUT   0

#define HIGH  1
#define LOW   0

void pinMode(uint32_t gpio, uint32_t mode)
{
    /* TODO: */
    return;
}

uint32_t digitalRead(uint32_t gpio)
{
    /* TODO: */
    return 0;
}

void digitalWrite(uint32_t gpio, uint32_t b)
{
    uint32_t offset = gpio & 0xF;

    if (b) {
        port_a |= (0x1 << offset);
    } else {
        port_a &= (~(0x1 << offset));
    }

}

int spi_init()
{
#if 0
	pinMode(GPIO_TFT_DC,  _OUTPUT);

	pinMode(GPIO_SPI_CS,  _OUTPUT);
	pinMode(GPIO_SPI_CLK, _OUTPUT);
	pinMode(GPIO_SPI_MOSI, _OUTPUT);
	pinMode(GPIO_SPI_MISO, _INPUT);
#endif

	return 0;
}

uint8_t spi_write(uint8_t c)
{
#if 0
	for(uint8_t bit = 0x80; bit; bit >>= 1) {
		if(c & bit) {
			digitalWrite(GPIO_SPI_MOSI, HIGH);
		} else {
			digitalWrite(GPIO_SPI_MOSI, LOW);
		}
		digitalWrite(GPIO_SPI_CLK, HIGH);
		digitalWrite(GPIO_SPI_CLK, LOW);
	}
#endif

     spi_xfer_single(c);

        return 0;
}

void tft_write_cmd(uint8_t c)
{

  digitalWrite(GPIO_TFT_DC, LOW);

  spi_write(c);

}

void tft_write_data(uint8_t c)
{
  digitalWrite(GPIO_TFT_DC, HIGH);

  spi_write(c);

}

void tft_set_addr_window(uint16_t x0, uint16_t y0, uint16_t x1,
 uint16_t y1) {

  digitalWrite(GPIO_TFT_DC, LOW);

  spi_write(ILI9341_CASET); // Column addr set

  digitalWrite(GPIO_TFT_DC, HIGH);

  spi_write(x0 >> 8);
  spi_write(x0 & 0xFF);     // XSTART
  spi_write(x1 >> 8);
  spi_write(x1 & 0xFF);     // XEND

  digitalWrite(GPIO_TFT_DC, LOW);
  spi_write(ILI9341_PASET); // Row addr set
  digitalWrite(GPIO_TFT_DC, HIGH);

  spi_write(y0>>8);
  spi_write(y0);     // YSTART
  spi_write(y1>>8);
  spi_write(y1);     // YEND

  digitalWrite(GPIO_TFT_DC, LOW);
  spi_write(ILI9341_RAMWR); // write to RAM
  digitalWrite(GPIO_TFT_DC, HIGH);
}

uint16_t _width  = ILI9341_TFTWIDTH;
uint16_t _height = ILI9341_TFTHEIGHT;

void tft_draw_pixel(int16_t x, int16_t y, uint16_t color)
{
    if((x < 0) || (x >= _width) || (y < 0) || (y >= _height)) {
        return;
    }

    tft_set_addr_window(x, y, x + 1, y + 1);

    spi_write(color >> 8);
    spi_write(color);

}

void tft_fill_rect(int16_t x, int16_t y, int16_t w, int16_t h, uint16_t color)
{

  // rudimentary clipping (drawChar w/big text requires this)
  if((x >= _width) || (y >= _height)) return;
  if((x + w - 1) >= _width)  w = _width  - x;
  if((y + h - 1) >= _height) h = _height - y;


  tft_set_addr_window(x, y, x+w-1, y+h-1);

  uint8_t hi = color >> 8, lo = color;

  for(y=h; y>0; y--) {
    for(x=w; x>0; x--) {
      spi_write(hi);
      spi_write(lo);
    }
  }

}

void tft_draw_rect(int16_t x, int16_t y, int16_t w, int16_t h, uint16_t *buf)
{

  uint32_t i = 0;
  uint8_t hi, lo;
  // rudimentary clipping (drawChar w/big text requires this)

  if((x >= _width) || (y >= _height)) return;
  if((x + w - 1) >= _width)  w = _width  - x;
  if((y + h - 1) >= _height) h = _height - y;


  tft_set_addr_window(x, y, x+w-1, y+h-1);

  for(y=h; y>0; y--) {
      for(x=w; x>0; x--) {

          hi = buf[i] >> 8;
          lo = buf[i++];
          spi_write(hi);
          spi_write(lo);
      }
  }

}

int tft_fill_screen(uint16_t color)
{
    tft_fill_rect(0, 0,  240, 320, color);
}

#if 1
int tft_init()
{
  spi_init();

  tft_write_cmd(0xEF);
  tft_write_data(0x03);
  tft_write_data(0x80);
  tft_write_data(0x02);

  tft_write_cmd(0xCF);
  tft_write_data(0x00);
  tft_write_data(0XC1);
  tft_write_data(0X30);

  tft_write_cmd(0xED);
  tft_write_data(0x64);
  tft_write_data(0x03);
  tft_write_data(0X12);
  tft_write_data(0X81);

  tft_write_cmd(0xE8);
  tft_write_data(0x85);
  tft_write_data(0x00);
  tft_write_data(0x78);

  tft_write_cmd(0xCB);
  tft_write_data(0x39);
  tft_write_data(0x2C);
  tft_write_data(0x00);
  tft_write_data(0x34);
  tft_write_data(0x02);

  tft_write_cmd(0xF7);
  tft_write_data(0x20);

  tft_write_cmd(0xEA);
  tft_write_data(0x00);
  tft_write_data(0x00);

  tft_write_cmd(ILI9341_PWCTR1);    //Power control
  tft_write_data(0x23);   //VRH[5:0]

  tft_write_cmd(ILI9341_PWCTR2);    //Power control
  tft_write_data(0x10);   //SAP[2:0];BT[3:0]

  tft_write_cmd(ILI9341_VMCTR1);    //VCM control
  tft_write_data(0x3e); //¶Ô±È¶Èµ÷½Ú
  tft_write_data(0x28);

  tft_write_cmd(ILI9341_VMCTR2);    //VCM control2
  tft_write_data(0x86);  //--

  tft_write_cmd(ILI9341_MADCTL);    // Memory Access Control
  tft_write_data(0x48);

  tft_write_cmd(ILI9341_PIXFMT);
  tft_write_data(0x55);

  tft_write_cmd(ILI9341_FRMCTR1);
  tft_write_data(0x00);
  tft_write_data(0x18);

  tft_write_cmd(ILI9341_DFUNCTR);    // Display Function Control
  tft_write_data(0x08);
  tft_write_data(0x82);
  tft_write_data(0x27);

  tft_write_cmd(0xF2);    // 3Gamma Function Disable
  tft_write_data(0x00);

  tft_write_cmd(ILI9341_GAMMASET);    //Gamma curve selected
  tft_write_data(0x01);

  tft_write_cmd(ILI9341_GMCTRP1);    //Set Gamma
  tft_write_data(0x0F);
  tft_write_data(0x31);
  tft_write_data(0x2B);
  tft_write_data(0x0C);
  tft_write_data(0x0E);
  tft_write_data(0x08);
  tft_write_data(0x4E);
  tft_write_data(0xF1);
  tft_write_data(0x37);
  tft_write_data(0x07);
  tft_write_data(0x10);
  tft_write_data(0x03);
  tft_write_data(0x0E);
  tft_write_data(0x09);
  tft_write_data(0x00);

  tft_write_cmd(ILI9341_GMCTRN1);    //Set Gamma
  tft_write_data(0x00);
  tft_write_data(0x0E);
  tft_write_data(0x14);
  tft_write_data(0x03);
  tft_write_data(0x11);
  tft_write_data(0x07);
  tft_write_data(0x31);
  tft_write_data(0xC1);
  tft_write_data(0x48);
  tft_write_data(0x08);
  tft_write_data(0x0F);
  tft_write_data(0x0C);
  tft_write_data(0x31);
  tft_write_data(0x36);
  tft_write_data(0x0F);

  tft_write_cmd(ILI9341_SLPOUT);    //Exit Sleep

  delay(120);
  delay(50000);

  tft_write_cmd(ILI9341_DISPON);    //Display on

}
#endif

#if 0
uint16_t icon[] = {
    0xffff, 0xffff, 0xffff, 0xffff, 0xffff, 0xffff, 0xffff, 0xffff, 0xffff, 0xffff, 0xffff, 0xffff,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 0xffff,
    0xffff, 0xffff, 0xffff, 0xffff, 0xffff, 0xffff, 0xffff, 0xffff, 0xffff, 0xffff, 0xffff, 0xffff,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 0xffff,
    0xffff, 0xffff, 0xffff, 0xffff, 0xffff, 0xffff, 0xffff, 0xffff, 0xffff, 0xffff, 0xffff, 0xffff,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 0xffff,
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    0xffff, 0xffff, 0xffff, 0xffff, 0xffff, 0xffff, 0xffff, 0xffff, 0xffff, 0xffff, 0xffff, 0xffff,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 0xffff, 0xffff};
#endif



/* spi lcd end   */

void main ()
{
    uint16_t *addr;
    uint8_t buffer[64];
    int8_t uart_rx = 0;
    int16_t x;

    //GPIO mode = output
    port_cfg = 0x00;

    //Initialize:
    uart_initialize(9600);
    //spi_config(0, 12); //1MHz
    spi_config(0, 1); //6MHz
    i2c_config(120); //100kHz

   	tft_init();

    uart_write("tft_fill_screen start\r\n");
    tft_fill_screen(ILI9341_GREEN);
    uart_write("tft_fill_screen end\r\n");

    tft_fill_rect(0, 0,   240, 40, ILI9341_MAROON);
    tft_fill_rect(0, 40,  240, 40, ILI9341_PURPLE);
    tft_fill_rect(0, 80,  240, 40, ILI9341_OLIVE);
    tft_fill_rect(0, 120, 240, 40, ILI9341_LIGHTGREY);

    tft_fill_rect(0, 160, 240, 40, ILI9341_BLUE);
    tft_fill_rect(0, 200, 240, 40, ILI9341_GREEN);
    tft_fill_rect(0, 240, 240, 40, ILI9341_CYAN);
    tft_fill_rect(0, 280, 240, 40, ILI9341_RED);

    //tft_draw_rect(100, 140, 51, 29, icon);
    //View_Memory(icon, sizeof(icon));


#if 0
    //i2c Test:
    i2c_read_buf(0x5C, buffer, 5); // DHT12
    View_Memory(buffer, 5);
    i2c_read_buf(0x68, buffer, 20); // PCF8523
    View_Memory(buffer, 20);

    //SPI Test
    Read_SPI_25L008A(buffer, 64); // 25L008A
    View_Memory(buffer, 64);
#endif

    //I2C OLED display test:
    oled_reset();
    ssd1306_initialize(0x3C);
    ssd1306_clear();
    ssd1306_write(0, 0, "iceZ0mb1e SoC");
    ssd1306_write(2, 0, "by abnoname");
    ssd1306_write(3, 0, "0123456789 Test");
    ssd1306_write(4, 0, "Framebuffer On");
#ifdef SSD1306_ENABLE_FRAMEBUFFER
    ssd1306_update();
#endif
#ifdef SSD1306_ENABLE_GRAPHIC
    ssd1306_line(0, 48, 127, 63, 1);
    ssd1306_box(0, 127, 48, 63, 1);
    ssd1306_update();
#endif

    //Port test
    port_a = 0x55;

    //UART Test
    snprintf(strbuf, sizeof(strbuf), "iceZ0mb1e SoC by abnoname\r\n");
    uart_write(strbuf);

    //UART Terminal
    while(1)
    {
        uart_rx = getchar();

        switch(uart_rx)
        {
            case 'a':
                port_a = getchar();
                snprintf(strbuf, sizeof(strbuf), "port_a = 0x%X\n\r", port_a);
                uart_write(strbuf);
                break;
            case 'b':
                port_b = getchar();
                snprintf(strbuf, sizeof(strbuf), "port_b = 0x%X\n\r", port_b);
                uart_write(strbuf);
                break;
            case 'r':
                cpu_reset();
                break;
            case 'c':
                View_Memory((uint8_t*)SYS_ROM_ADDR, SYS_ROM_SIZE);
                break;
            case 'm':
                View_Memory((uint8_t*)SYS_RAM_ADDR, SYS_RAM_SIZE);
                break;
            case 't':
                //RAM Test
                last_usable_addr = 0;
                addr = &free;
                while((uint16_t)addr < (SYS_RAM_ADDR+SYS_RAM_SIZE))
                {
                    *(addr) = (uint16_t)addr;
                    if(*(addr) != addr)
                    {
                        break;
                    }
                    last_usable_addr = (uint16_t)addr;
                    addr++;
                }
                snprintf(strbuf, sizeof(strbuf), "RAM: start = 0x%X, last usable = 0x%X, ramsize = %u\n\r",
                    (uint16_t)&start, last_usable_addr, last_usable_addr-(uint16_t)&start
                );
                uart_write(strbuf);
                break;
            default:
                putchar(uart_rx);
                break;
        }
    }
}
